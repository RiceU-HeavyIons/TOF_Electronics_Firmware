  		
	-- Filename : sm_sync_enable.vhd
	--
	-- Date : 9/10/04
	-- Author : L. Bridges / Blue Sky Electronics, LLC
	--
	-- This module synchronizes the data strobe generated by the 4bit to 32bit demux
	-- which receives the TDIG data. It generates a 1 clock data_valid strobe that 
	-- can be used as a clock enable to clock the 32bit data into a FIFO. Since 
	-- the 32bit data goes thru a 2-stage pipeline,
	-- the data_valid strobe is only generated on the 
	-- SECOND and following data input strobes after RESET.
	--
            
    LIBRARY ieee; USE ieee.std_logic_1164.all;           
    LIBRARY lpm; USE lpm.lpm_components.all;

	use work.picotof_package.all;

	entity sm_sync_enable is
		port( rega_enable : in std_logic;										
			clk : in std_logic;			-- master tcpu clk
			reset : in std_logic;		-- used for asynchronous reset
			regb_enable : out std_logic; -- clock enable for register b
			output_valid : out std_logic; -- to be used as clock enable putting 
						 -- the 32bit TDIG word into a fifo
			ff1, ff2, ff3, ff4 : out std_logic -- test signals
			); 
			
			
	end sm_sync_enable;
	
	architecture lwb1 of sm_sync_enable is 
	
		
		signal synced_enable : std_logic;
		
		signal ff1_out, ff2_out, ff3_out, ff4_out, ff3_data, ff4_data : std_logic;	   
		
	begin
		
		-- use rega_enable to create a clock enable, synchronous with main 40 mhz 'clk' 
		-- and 25ns wide	
		
		rega_sm_ff1 : DFF_sclr PORT MAP (
			clock	 => rega_enable,
			sclr	 => '0',
			aclr 	 => ff2_out,
			data	 => '1',
			q	 => ff1_out);
		
		-- ff2_out is a synchronized version of the clock enable for the 
		-- 1st 32bit register
		
		rega_sm_ff2 : DFF_sclr PORT MAP (
			clock	 => clk,
			sclr	 => ff2_out,
			aclr 	 => reset,
			data	 => ff1_out,
			q	 => ff2_out);
			
		regb_enable <= ff2_out;  
		
		-- ff to give 1 clock data valid pulse
		
		ff3_data <= ff2_out and ff4_out;
	
		rega_sm_ff3 : DFF_sclr PORT MAP (
			clock	 => clk,
			sclr	 => ff3_out,
			aclr 	 => reset,
			data	 => ff3_data,
			q	 => ff3_out);
			
		output_valid <= ff3_out;

		-- The ser4_to_par block has a 2-stage pipeline.
		-- After a reset, the first clock enable strobe to the 2nd register will 
		-- clock invalid data, since the pipeline is not full.
		--
		-- FF4 waits until the 2nd clock enable input after a reset to begin the 
		-- output (32bit data valid) strobe.
		-- 
		-- The TDIG should always stuff a dummy word at the end of every 
		-- group so that the last word is flushed from the fifo.
		--
		
		-- ff4 is cleared by reset, and set by rega_en
		-- Therefore, ff4 will be hi when the SECOND rega_enable signal arrives, 
		-- and this ff can be
		-- used to gate the data valid output strobe from this module (ff3)
		
		ff4_data <= ff2_out or ff4_out;
		
		rega_sm_ff4 : DFF_sclr PORT MAP (
			clock	 => clk,
			sclr	 => '0',
			aclr 	 => reset,   
			data	 => ff4_data,
			q	 => ff4_out);
		
		-- test signals
		
		ff1 <= ff1_out;
		ff2 <= ff2_out;
		ff3 <= ff3_out;
		ff4 <= ff4_out;
	
	end architecture;
